## CMakeLists.txt
```
cmake_minimum_required(VERSION 3.20.0)

find_package(Zephyr REQUIRED HINTS $ENV{ZEPHYR_BASE})
project(nrf52840_canon_remote)

target_sources(app PRIVATE
    src/main.c
    src/canon_ble_zephyr.c
    src/shell_commands.c
    ../../shared/canon/src/canon_protocol.c
)

target_include_directories(app PRIVATE
    src
    ../../shared/canon/include
)

target_compile_options(app PRIVATE -Wall -Wextra -Werror)
```

## west.yml
```
manifest:
  version: "1.2"

  projects:
    - name: zephyr
      url: https://github.com/zephyrproject-rtos/zephyr
      revision: v4.2.0
      clone-depth: 1
      import:
        path-prefix: .platformio/zephyr-workspace
        name-allowlist:
          - cmsis
          - cmsis_6
          - hal_nordic
          - mbedtls
          - tinycrypt

  self:
    path: nrf52840
```

## prj.conf
```kconfig
# USB CDC serial shell
CONFIG_SERIAL=y
CONFIG_CONSOLE=y
CONFIG_UART_CONSOLE=y
CONFIG_UART_LINE_CTRL=y
CONFIG_USB_DEVICE_STACK=y
CONFIG_USB_DEVICE_INITIALIZE_AT_BOOT=y
CONFIG_SHELL=y
CONFIG_SHELL_BACKEND_SERIAL=y
CONFIG_SHELL_BACKEND_SERIAL_CHECK_DTR=y
CONFIG_SHELL_PROMPT_UART="nrf52840> "
CONFIG_SHELL_CMD_BUFF_SIZE=128
CONFIG_SHELL_STACK_SIZE=4096
CONFIG_SHELL_HELP=y
CONFIG_SHELL_HELP_ON_WRONG_ARGUMENT_COUNT=y
CONFIG_LOG=y
CONFIG_LOG_DEFAULT_LEVEL=3
CONFIG_SHELL_LOG_BACKEND=y
CONFIG_LOG_BACKEND_UART=n

# BLE central, GATT client, pairing, bonding, and persistent keys
CONFIG_BT=y
CONFIG_BT_CENTRAL=y
CONFIG_BT_GATT_CLIENT=y
CONFIG_BT_MAX_CONN=1
CONFIG_BT_MAX_PAIRED=2
CONFIG_BT_SMP=y
CONFIG_BT_BONDABLE=y
CONFIG_BT_SETTINGS=y
CONFIG_BT_DEVICE_NAME="nRF Remote"
# Canon cameras use unauthenticated pairing and some models may use legacy SMP.
CONFIG_BT_SMP_SC_PAIR_ONLY=n
CONFIG_BT_SMP_ENFORCE_MITM=n
CONFIG_BT_CREATE_CONN_TIMEOUT=15
CONFIG_BT_ATT_TX_COUNT=4

# The UF2 board target provides a 32 KiB storage partition at 0xEC000.
CONFIG_FLASH=y
CONFIG_FLASH_MAP=y
CONFIG_FLASH_PAGE_LAYOUT=y
CONFIG_NVS=y
CONFIG_SETTINGS=y
CONFIG_SETTINGS_NVS=y
CONFIG_MPU_ALLOW_FLASH_WRITE=y

CONFIG_REBOOT=y
CONFIG_MAIN_STACK_SIZE=2048
CONFIG_SYSTEM_WORKQUEUE_STACK_SIZE=2048
```

## src/main.c
```c
#include <zephyr/kernel.h>
#include <zephyr/logging/log.h>

#include "canon_ble_zephyr.h"

LOG_MODULE_REGISTER(main, LOG_LEVEL_INF);

int main(void)
{
    const canon_zephyr_result_t result = canon_ble_zephyr_initialize();
    if (result != CANON_ZEPHYR_OK) {
        LOG_ERR("Canon BLE initialization failed: %s",
                canon_ble_zephyr_result_name(result));
    } else {
        LOG_INF("Pro Micro nRF52840 serial services ready");
    }

    return 0;
}
```

## src/canon_ble_zephyr.h
```c
#ifndef CANON_BLE_ZEPHYR_H
#define CANON_BLE_ZEPHYR_H

#include <stdbool.h>
#include <stdint.h>

#define CANON_ZEPHYR_ADDRESS_TEXT_SIZE 30U

typedef enum {
    CANON_ZEPHYR_OK = 0,
    CANON_ZEPHYR_BUSY,
    CANON_ZEPHYR_NOT_READY,
    CANON_ZEPHYR_NOT_PAIRED,
    CANON_ZEPHYR_NOT_FOUND,
    CANON_ZEPHYR_TIMEOUT,
    CANON_ZEPHYR_INVALID_ARGUMENT,
    CANON_ZEPHYR_STACK_ERROR,
} canon_zephyr_result_t;

typedef struct {
    bool initialized;
    bool host_ready;
    bool paired;
    bool connected;
    bool encrypted;
    bool ready;
    bool scanning;
    bool busy;
    char camera_address[CANON_ZEPHYR_ADDRESS_TEXT_SIZE];
    int last_ble_error;
} canon_zephyr_status_t;

canon_zephyr_result_t canon_ble_zephyr_initialize(void);
canon_zephyr_result_t canon_ble_zephyr_pair(uint32_t scan_seconds);
canon_zephyr_result_t canon_ble_zephyr_connect(void);
canon_zephyr_result_t canon_ble_zephyr_disconnect(void);
canon_zephyr_result_t canon_ble_zephyr_forget(void);
canon_zephyr_result_t canon_ble_zephyr_shutter(void);
canon_zephyr_result_t canon_ble_zephyr_focus(void);
void canon_ble_zephyr_get_status(canon_zephyr_status_t *status);
const char *canon_ble_zephyr_result_name(canon_zephyr_result_t result);

#endif
```

## src/shell_commands.c
```c
#include <errno.h>
#include <stdlib.h>
#include <string.h>

#include <zephyr/kernel.h>
#include <zephyr/shell/shell.h>
#include <zephyr/sys/reboot.h>
#include <zephyr/version.h>

#include "canon_ble_zephyr.h"

#define DEFAULT_SCAN_SECONDS 15U
#define MAX_SCAN_SECONDS 60U

static int print_result(const struct shell *shell, const char *operation,
                        canon_zephyr_result_t result)
{
    if (result == CANON_ZEPHYR_OK) {
        shell_print(shell, "%s succeeded", operation);
        return 0;
    }

    canon_zephyr_status_t status;
    canon_ble_zephyr_get_status(&status);
    if (status.last_ble_error != 0) {
        shell_error(shell, "%s failed: %s (Zephyr BLE error %d)",
                    operation, canon_ble_zephyr_result_name(result),
                    status.last_ble_error);
    } else {
        shell_error(shell, "%s failed: %s", operation,
                    canon_ble_zephyr_result_name(result));
    }
    return -ENOEXEC;
}

static int parse_scan_seconds(const char *text, uint32_t *seconds)
{
    char *end = NULL;
    errno = 0;
    const unsigned long value = strtoul(text, &end, 10);
    if (errno != 0 || end == text || *end != '\0' || value == 0U ||
        value > MAX_SCAN_SECONDS) {
        return -EINVAL;
    }
    *seconds = (uint32_t)value;
    return 0;
}

static int command_camera_pair(const struct shell *shell, size_t argc,
                               char **argv)
{
    uint32_t seconds = DEFAULT_SCAN_SECONDS;
    if (argc == 2U && parse_scan_seconds(argv[1], &seconds) != 0) {
        shell_error(shell, "seconds must be between 1 and %u",
                    MAX_SCAN_SECONDS);
        return -EINVAL;
    }

    shell_print(shell, "Put the camera in Bluetooth Remote pairing mode.");
    shell_print(shell, "Scanning for the Canon service for %u seconds...",
                seconds);
    return print_result(shell, "Pairing",
                        canon_ble_zephyr_pair(seconds));
}

static int command_camera_connect(const struct shell *shell, size_t argc,
                                  char **argv)
{
    (void)argc;
    (void)argv;
    return print_result(shell, "Connection", canon_ble_zephyr_connect());
}

static int command_camera_shutter(const struct shell *shell, size_t argc,
                                  char **argv)
{
    (void)argc;
    (void)argv;
    return print_result(shell, "Shutter", canon_ble_zephyr_shutter());
}

static int command_camera_focus(const struct shell *shell, size_t argc,
                                char **argv)
{
    (void)argc;
    (void)argv;
    return print_result(shell, "Focus", canon_ble_zephyr_focus());
}

static int command_camera_status(const struct shell *shell, size_t argc,
                                 char **argv)
{
    (void)argc;
    (void)argv;

    canon_zephyr_status_t status;
    canon_ble_zephyr_get_status(&status);
    shell_print(shell, "BLE service: %s",
                status.initialized ? "initialized" : "unavailable");
    shell_print(shell, "BLE host:    %s",
                status.host_ready ? "ready" : "not ready");
    shell_print(shell, "Paired:      %s", status.paired ? "yes" : "no");
    shell_print(shell, "Camera:      %s",
                status.paired ? status.camera_address : "<none>");
    shell_print(shell, "Connection:  %s",
                status.connected ? "connected" : "disconnected");
    shell_print(shell, "Encrypted:   %s",
                status.encrypted ? "yes" : "no");
    shell_print(shell, "Control:     %s",
                status.ready ? "ready" : "not ready");
    shell_print(shell, "Scanning:    %s",
                status.scanning ? "yes" : "no");
    shell_print(shell, "Operation:   %s", status.busy ? "busy" : "idle");
    if (status.last_ble_error != 0) {
        shell_print(shell, "Last Zephyr BLE error: %d",
                    status.last_ble_error);
    }
    return 0;
}

static int command_camera_disconnect(const struct shell *shell, size_t argc,
                                     char **argv)
{
    (void)argc;
    (void)argv;
    return print_result(shell, "Disconnect",
                        canon_ble_zephyr_disconnect());
}

static int command_camera_forget(const struct shell *shell, size_t argc,
                                 char **argv)
{
    (void)argc;
    (void)argv;
    return print_result(shell, "Forget", canon_ble_zephyr_forget());
}

static int command_camera_help(const struct shell *shell, size_t argc,
                               char **argv)
{
    (void)argc;
    (void)argv;
    shell_print(shell, "Canon camera commands:");
    shell_print(shell, "  camera pair [seconds]");
    shell_print(shell, "  camera connect");
    shell_print(shell, "  camera shutter");
    shell_print(shell, "  camera focus");
    shell_print(shell, "  camera status");
    shell_print(shell, "  camera disconnect");
    shell_print(shell, "  camera forget");
    return 0;
}

SHELL_STATIC_SUBCMD_SET_CREATE(
    camera_subcommands,
    SHELL_CMD_ARG(pair, NULL, "Pair a Canon camera [seconds]",
                  command_camera_pair, 1, 1),
    SHELL_CMD(connect, NULL, "Connect to the saved camera",
              command_camera_connect),
    SHELL_CMD(shutter, NULL, "Take a photo or toggle movie recording",
              command_camera_shutter),
    SHELL_CMD(focus, NULL, "Send a focus command", command_camera_focus),
    SHELL_CMD(status, NULL, "Show camera connection state",
              command_camera_status),
    SHELL_CMD(disconnect, NULL, "Close the camera connection",
              command_camera_disconnect),
    SHELL_CMD(forget, NULL, "Remove the saved camera and BLE bond",
              command_camera_forget),
    SHELL_CMD(help, NULL, "Show Canon camera commands", command_camera_help),
    SHELL_SUBCMD_SET_END);

SHELL_CMD_REGISTER(camera, &camera_subcommands,
                   "Pair and control a Canon camera over BLE", NULL);

static int command_sysinfo(const struct shell *shell, size_t argc, char **argv)
{
    (void)argc;
    (void)argv;
    shell_print(shell, "Target: Pro Micro nRF52840 (Cortex-M4F)");
    shell_print(shell, "Zephyr: %s", KERNEL_VERSION_STRING);
    shell_print(shell, "Uptime: %lld s",
                (long long)(k_uptime_get() / 1000));
    return 0;
}

SHELL_CMD_REGISTER(sysinfo, NULL, "Show target, Zephyr, and uptime",
                   command_sysinfo);

static int command_reboot(const struct shell *shell, size_t argc, char **argv)
{
    (void)argc;
    (void)argv;
    shell_print(shell, "Restarting...");
    k_msleep(50);
    sys_reboot(SYS_REBOOT_COLD);
    return 0;
}

SHELL_CMD_REGISTER(reboot, NULL, "Restart the nRF52840", command_reboot);
```
